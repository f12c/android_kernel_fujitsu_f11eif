## drivers/fujitsu/Kconfig
```kconfig
#
# fujitsu f11eif device driver
#

menuconfig FUJITSU_F11EIF
	bool "Fujitsu f11eif drivers"
	default y
	---help---
	  Say Y here to get to see options for device drivers from various
	  different categories. This option alone does not add any kernel code.

	  If you say N, all options in this submenu will be skipped and disabled.

if FUJITSU_F11EIF

config FUJITSU_EIFFEL_PROXIMITY
	bool "Fujitsu Proximity sensor Devices driver"
	default y
	---help---
	  If you say yes here you get support for the Eiffel Proximity sensor
	  chips.

	  This driver can also be built as a module. If so, the module
	  will be called proximity sensor.

config FUJITSU_EIFFEL_ILLUMI
	bool "Fujitsu Illuminance sensor Devices driver"
	depends on FUJITSU_EIFFEL_PROXIMITY
	default y
	---help---
	  If you say yes here you get support for the Eiffel Illuminance
	  sensor chips.

	  This driver can also be built as a module. If so, the module
	  will be called proximity sensor.

source "drivers/fujitsu/keypad/Kconfig"

config FUJITSU_F11EIF_STSCHK
	bool "Fujitsu Status Check driver"
	default y
	---help---
	  Say Y here if you want to enable the driver for the F11EIF's ststus check.
	  This is the driver to check root hackking.

	  the module will be called system call.

endif # FUJITSU_F11EIF
```

## drivers/fujitsu/i2cuart/Kconfig
```kconfig
#
# Fujitsu I2CUART Exchange driver
#

config FUJITSU_F11EIF_I2CUART
	bool "Fujitsu I2CUART Exchange driver support"
	default y
	help
	  Say Y here to enable based i2cuart support.
```

## drivers/fujitsu/keypad/Kconfig
```kconfig
config FUJITSU_F11EIF_KEYPAD
	bool "Fujitsu HW Key Devices driver"
	default y
	---help---
	  Say Y here if you want to enable the driver for the F11EIF's keypad.
	  This is intended to support it's hard key.

	  To compile this driver as a module, choose M here: the module will
	  be called keypad.
```

## drivers/fujitsu/walkmotion/Kconfig
```kconfig
config CONFIG_FUJITSU_F11EIF_WALKMOTION
	tristate "WalkMotion driver support"
	default y
	help
	  Say Y here to enable based walkMotion support.
```

## drivers/tspdrv/Kconfig
```kconfig
#
# TouchSense configuration
#

menuconfig TSPDRV
	bool "TouchSense support"
	default y
	---help---
	  This is TouchSense Kconfig.
```

## drivers/waveif/Kconfig
```kconfig
menu "Fujitsu WAVE-IF support"

config FUJITSU_WAVEIF
	tristate "Fujitsu WAVE Interface Driver"
	default y
endmenu
```
